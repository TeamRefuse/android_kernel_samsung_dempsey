## arch/arm/mach-s5pv210/Kconfig
```kconfig
# arch/arm/mach-s5pv210/Kconfig
#
# Copyright (c) 2010 Samsung Electronics Co., Ltd.
#		http://www.samsung.com/
#
# Licensed under GPLv2

# Configuration options for the S5PV210/S5PC110

if ARCH_S5PV210

config CPU_S5PV210
	bool
	select PLAT_S5P
	select S3C_PL330_DMA
	select S5P_EXT_INT
	help
	  Enable S5PV210 CPU support

config S5PV210_SETUP_I2C1
	bool
	depends on S3C_DEV_I2C1
	default	y
	help
	  Common setup code for i2c bus 1.

config S5PV210_SETUP_I2C2
	bool
	depends on S3C_DEV_I2C2
	default	y
	help
	  Common setup code for i2c bus 2.

config S5PV210_SETUP_FB_24BPP
	bool
	help
          Common setup code for S5PV210 with an 24bpp RGB display helper.

config S5PV210_SETUP_SDHCI
        bool
        select S5PV210_SETUP_SDHCI_GPIO
        help
          Internal helper functions for S5PV210 based SDHCI systems

config S5PV210_SETUP_SDHCI_GPIO
	bool
	help
	  Common setup code for SDHCI gpio.

config S5PV210_POWER_DOMAIN
	bool
	depends on REGULATOR
	default y
	help
	  Enable S5PV210 power domain support.

# machine support

config MACH_AQUILA
	bool "Samsung Aquila"
	select CPU_S5PV210
	select ARCH_SPARSEMEM_ENABLE
	select S5PV210_SETUP_FB_24BPP
	select S3C_DEV_FB
	help
	  Machine support for the Samsung Aquila target based on S5PC110 SoC

config MACH_GONI
	bool "GONI"
	select CPU_S5PV210
	select ARCH_SPARSEMEM_ENABLE
	help
	  Machine support for Samsung GONI board
	  S5PC110(MCP) is one of package option of S5PV210

comment "MMC/SD slot setup"
depends on PLAT_S5P

menu "Use 8-bit bus width"
config S5PV210_SD_CH0_8BIT
bool "Channel 0"
depends on PLAT_S5P
default n
help
IF channel 0 uses 8-bit bus, channel 1 is disabled.

config S5PV210_SD_CH2_8BIT
bool "Channel 2"
depends on PLAT_S5P
default n
help
IF channel 2 uses 8-bit bus, channel 3 is disabled.
endmenu

config S5PC110_DEV_ONENAND
	bool
	default y if CPU_S5PV210
	help 
	  Compile in platform device definition for OneNAND1 controller

config MACH_SMDKV210
	bool "SMDKV210"
	select CPU_S5PV210
	select ARCH_SPARSEMEM_ENABLE
	select SAMSUNG_DEV_ADC
	select SAMSUNG_DEV_TS
	select S3C_DEV_WDT
	select HAVE_S3C2410_WATCHDOG
	help
	  Machine support for Samsung SMDKV210

config MACH_SMDKC110
	bool "SMDKC110"
	select CPU_S5PV210
	select ARCH_SPARSEMEM_ENABLE
	select S3C_DEV_WDT
	select HAVE_S3C2410_WATCHDOG
	help
	  Machine support for Samsung SMDKC110
	  S5PC110(MCP) is one of package option of S5PV210

config MACH_HERRING
	bool "Herring"
	select CPU_S5PV210
	select ARCH_DISCONTIGMEM_ENABLE
	select S3C_DEV_WDT
	select HAVE_S3C2410_WATCHDOG
	select S3C_DEV_I2C1
	select S3C_DEV_I2C2
	select HAVE_PWM
	select ARCH_HAS_CPUFREQ
	select S3C_DEV_HSMMC
	select S3C_DEV_HSMMC1 if !S5PV210_SD_CH0_8BIT
	select S3C_DEV_HSMMC3 if !S5PV210_SD_CH2_8BIT
	select S5PV210_SETUP_SDHCI
	select S5PV210_POWER_DOMAIN
	help
	  Machine support for Herring

config MACH_ARIES
	bool "Aries"
	select CPU_S5PV210
	select ARCH_DISCONTIGMEM_ENABLE
	select S3C_DEV_WDT
	select HAVE_S3C2410_WATCHDOG
	select S3C_DEV_I2C1
	select S3C_DEV_I2C2
	select HAVE_PWM
	select ARCH_HAS_CPUFREQ
#        select S3C_DEV_HSMMC
#        select S3C_DEV_HSMMC1 if !S5PV210_SD_CH0_8BIT
#        select S3C_DEV_HSMMC2
#        select S3C_DEV_HSMMC3
	select S5PV210_SETUP_SDHCI
	select S5PV210_POWER_DOMAIN
	help
	  Machine support for Aries

choice
	prompt "Select NA USA BOARD TYPE "

config S5PC110_KEPLER_BOARD
	bool "S5PC110_KEPLER"
	select S3C_DEV_HSMMC
        select S3C_DEV_HSMMC1 if !S5PV210_SD_CH0_8BIT
        select S3C_DEV_HSMMC2
	help
		select NA USA Board 

config S5PC110_T959_BOARD
	bool "S5PC110_T959"
	select S3C_DEV_HSMMC
        select S3C_DEV_HSMMC1 if !S5PV210_SD_CH0_8BIT
        select S3C_DEV_HSMMC2
	help
		select NA USA Board 


config S5PC110_HAWK_BOARD
	bool "S5PC110_HAWK"
	select S3C_DEV_HSMMC1 if !S5PV210_SD_CH0_8BIT
        select S3C_DEV_HSMMC2
	help
		select NA USA Board 
		
config S5PC110_VIBRANTPLUS_BOARD
	bool "S5PC110_VIBRANTPLUS"
        select S3C_DEV_HSMMC1 if !S5PV210_SD_CH0_8BIT
        select S3C_DEV_HSMMC2
	help
		select NA USA Board		
		
config S5PC110_FLEMING_BOARD
	bool "S5PC110_fleming"
	select S3C_DEV_HSMMC
	select S3C_DEV_HSMMC1 if !S5PV210_SD_CH0_8BIT
        select S3C_DEV_HSMMC2
	help
		select NA USA Board 


config S5PC110_DEMPSEY_BOARD
	bool "S5PC110_DEMPSEY"
        select S3C_DEV_HSMMC
        select S3C_DEV_HSMMC1 if !S5PV210_SD_CH0_8BIT
        select S3C_DEV_HSMMC2
        select S3C_DEV_HSMMC3
	help
		select NA USA Board 

		
endchoice 

choice 
        prompt "Select KEPLER BOARD VERSION "
config KEPLER_VER_B2
        bool "add KEPLER VERSION B0"
        depends on S5PC110_KEPLER_BOARD
        help
         add kepler ver B2 option 
         
endchoice

choice 
	prompt "Select T959 BOARD VERSION"
	
config T959_VER_B5
        bool "add T959 VERSION"
         depends on S5PC110_T959_BOARD
        help
         add T959 ver B5 option 
         
endchoice 

choice 
	prompt "Select HAWK BOARD VERSION"
         
config HAWK_VER_B0
        bool "add HAWK VERSION"
         depends on S5PC110_HAWK_BOARD
        help
         add HAWK ver B0 option 
endchoice 

config HAWK_VER_B0_HW_FIX
        bool "add HAWK VERSION"
         depends on S5PC110_HAWK_BOARD
        help
         add HAWK ver B0 option and HW FIX

config HAWK_VER_B1_REAL_ADDED_FEATURE
        bool "add HAWK VERSION"
         depends on S5PC110_HAWK_BOARD
        help
         add HAWK ver Real B1 option 

choice 
	prompt "Select VIBRANTPLUS BOARD VERSION"
         
config VIBRANTPLUS_VER_B0
        bool "add VIBRANTPLUS VERSION"
         depends on S5PC110_VIBRANTPLUS_BOARD
        help
         add VIBRANTPLUS ver B0 option 
endchoice 

choice 
	prompt "Select FLEMING BOARD VERSION"
	
config FLEMING_VER_B0
        bool "add fleming VERSION"
         depends on S5PC110_FLEMING_BOARD
        help
         add fleming ver B0 option 
         
endchoice 


config S5PC110_DEMPSEYR_BOARD
	bool "S5PC110_DEMPSEY Rogers"
	depends on S5PC110_DEMPSEY_BOARD
	default n
	help
	 add dempsey rogers option
		

choice 
	prompt "Select DEMPSEY BOARD VERSION"
         
config DEMPSEY_VER_B0
        bool "add DEMPSEY VERSION"
         depends on S5PC110_DEMPSEY_BOARD
        help
         add DEMPSEY ver B0 option 
endchoice 

config GPS_CHIPSET_STE_GNS7560
        bool "add GPS GNS7560"
        default n
        help
         add  GPS config

config GPS_CHIPSET_STE_CG2900
        bool "add GPS GNS2900"
        default n
        help
         add  GPS config

config ARIES_EUR
	bool "select S1 Europe"
	depends on MACH_ARIES
	help
	Select S1 Europe

config ARIES_NTT
	bool "select S1 NTT"
	depends on MACH_ARIES
	help
	Select S1 NTT

config ARIES_LATONA
	bool "select S1 LATONA"
	depends on MACH_ARIES
	help
	Select S1 LATONA

config S5PV210_SETUP_FB
	bool
	depends on FB_S3C
	default y
	help
	  Common setup code for FIMD controller.

config S5P_ADC
	bool	"S5PXXXX ADC driver"
	depends on PLAT_S5P
	default y
	help
	  ADC ( A/D Conversion ) driver for Samsung S5PXXXX

config S5PV210_SETUP_FIMC0
	bool
	depends on VIDEO_FIMC
	default y
	help
	  Common setup code for FIMC controller 0.

config S5PV210_SETUP_FIMC1
	bool
	depends on VIDEO_FIMC
	default y
	help
	  Common setup code for FIMC controller 1.

config S5PV210_SETUP_FIMC2
	bool
	depends on VIDEO_FIMC
	default y
	help
	  Common setup code for FIMC controller 2.

config S5PV210_SETUP_CSIS
	bool
	depends on VIDEO_FIMC
	default y
	help
	  Common setup code for MIPI-CSIS

config WIFI_CONTROL_FUNC
       bool "Enable WiFi control function abstraction"
       help
         Enables Power/Reset/Carddetect function abstraction

config DVFS_LIMIT
	bool "DVFS limit"
	depends on CPU_FREQ
	default n

config CPU_DIDLE
	bool "DEEP Idle"
	depends on CPU_IDLE
	default n
	
endif
```

## drivers/sensor/accel/Kconfig
```kconfig
#
# Accelerometer Sensor Configuration
#



config ACCEL                                                              
	bool "Accelerometer Sensor"
	default y
	help
	This option enables accelerometer sensors  
	   

config ACCEL_BMA020
	depends on ACCEL
	tristate "BMA020 driver for s5pc110"
	default n
	help
	  This option enables accelerometer sensors using bma020 driver.

config ACCEL_SMB380
	depends on ACCEL
	tristate "ACCEL_SMB380 driver for s5pc110"
	default y
	help
	  This option enables accelerometer sensors using bma020 driver.
	  It is optimized for s3c6410.

config ACCEL_BMA222
	depends on ACCEL
	tristate "BMA222 driver for s5pc110"
	default n
	help
	  This option enables accelerometer sensors using bma020 driver.
	  
config SENSORS_KR3D_ACCEL
	tristate "KR3Dx acceleration sensor support"
	depends on I2C=y
	depends on ACCEL
	default n
	help
	  If you say yes here you get support for STMicro's 
	  
```

## drivers/sensor/compass/Kconfig
```kconfig
#
# MAGNETIC Sensor Configuration
#

config COMPASS
	bool "MAGNETIC Sensor"
	default y
	help
	This option enables magnetic sensors  


config COMPASS_YAMAHA
	depends on COMPASS
	tristate "YAMAHA"
	default n
	help
	  This option enables magnetic sensors using YAMAHA driver.
	  It is optimized for s3c6410.

config SENSORS_AK8975C
	tristate "AK8975"
	depends on I2C=y
	depends on COMPASS
	default y
	help
	  If you say yes here you get support for Asahi Kasei's 
	  orientation sensor AK8975.
```

## drivers/sensor/optical/Kconfig
```kconfig
#
# Optical Sensor Configuration
#



config OPTICAL                                                              
	bool "Optical Sensor"
	default n
	help
	This option enables proximity & light sensors  
	   

config OPTICAL_GP2A
	depends on OPTICAL
	tristate "GP2A driver for s5pc110"
	default y
	help
	  This option enables proximity & light sensors using gp2a driver.
	  It is optimized for s3c6410.
	  
config OPTICAL_TAOS_TRITON
	depends on OPTICAL
	tristate "TAOS triton driver for s5pc110"
	default n
	help
	  This option enables proximity & light sensors using Texas Advanced Optoelectronic Solutions TAOS Ambient Light Sensor ALS Triton driver.
	  It is under test for s5pc110.
config OPTICAL_CAPELLA_TRITON
	depends on OPTICAL
	tristate "CAPELLA triton driver for s5pc110"
	default n
	help
	  CAPELLA
```
